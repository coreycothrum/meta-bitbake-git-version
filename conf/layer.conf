## conf/layer.conf
```bitbake
# We have a conf and classes directory, add to BBPATH
BBPATH .= ":${LAYERDIR}"

# We have recipes-* directories, add to BBFILES
BBFILES += "${LAYERDIR}/recipes-*/*/*.bb \
            ${LAYERDIR}/recipes-*/*/*.bbappend"

BBFILE_COLLECTIONS += "bitbake-git-version"
BBFILE_PATTERN_bitbake-git-version = "^${LAYERDIR}/"

INHERIT += "bitbake-git-version-vars"

LAYERDEPENDS_bitbake-git-version = "core"
LAYERSERIES_COMPAT_bitbake-git-version = "kirkstone"
```
